## conf/bblayers.conf
```bitbake
# POKY_BBLAYERS_CONF_VERSION is increased each time build/conf/bblayers.conf
# changes incompatibly
POKY_BBLAYERS_CONF_VERSION = "2"

# NXP ASK fast path dependencies for CMM and dpa_app
TOOLCHAIN_TARGET_TASK:append = " libmnl-dev libnfnetlink-dev libnetfilter-conntrack-dev libcli-dev"

BBPATH = "${TOPDIR}"
BBFILES ?= ""

BBMASK += "/meta-qoriq/meta-qoriq-bsp/recipes-containers/lxc/"
BBMASK += "/meta-qoriq/meta-qoriq-sdk/recipes-fsl/images/fsl-image-multimedia-full.bbappend"
BBMASK += "/meta-qoriq/meta-qoriq-sdk/recipes-fsl/packagegroups/packagegroup-fsl-gstreamer1.0.bbappend"

BBLAYERS ?= " \
  ${TOPDIR}/../sources/poky/meta \
  ${TOPDIR}/../sources/poky/meta-poky \
  ${TOPDIR}/../sources/poky/meta-yocto-bsp \
  ${TOPDIR}/../sources/poky/meta-arm/meta-arm \
  ${TOPDIR}/../sources/poky/meta-arm/meta-arm-toolchain \
  ${TOPDIR}/../sources/meta-freescale \
  ${TOPDIR}/../sources/meta-monogateway \
  ${TOPDIR}/../sources/meta-mono/meta-mono-bsp \
  ${TOPDIR}/../sources/meta-mono/meta-mono-sdk \
  ${TOPDIR}/../sources/meta-openembedded/meta-networking \
  ${TOPDIR}/../sources/meta-openembedded/meta-oe \
  ${TOPDIR}/../sources/meta-openembedded/meta-filesystems \ 
  ${TOPDIR}/../sources/meta-openembedded/meta-python \
  ${TOPDIR}/../sources/meta-qoriq/meta-qoriq-bsp \  
  ${TOPDIR}/../sources/meta-qoriq/meta-qoriq-sdk \  
  "
```

## conf/distro/gatewayos.conf
```bitbake
DISTRO = "gatewayos"
DISTRO_NAME = "Gateway Linux Distribution"
DISTRO_VERSION = "1.0"

# Use systemd as init manager
INIT_MANAGER = "systemd"
VIRTUAL-RUNTIME_init_manager = "systemd"
VIRTUAL-RUNTIME_initscripts = "systemd-compat-units"

# Distro features
DISTRO_FEATURES = "ext2 ipv4 ipv6 largefile systemd usbgadget usbhost vpp pam virtualization polkit security pulseaudio i2c-tools curl gzip nano apache2 alsa-lib alsa-utils nano usbutils"
DISTRO_FEATURES:remove = "rpm"
```

## conf/distro/mono-dev.conf
```bitbake
DISTRO = "mono-dev"
DISTRO_NAME = "Mono Gateway Linux Distribution"
DISTRO_VERSION = "1.0"


# Use systemd as init manager
INIT_MANAGER = "systemd"
VIRTUAL-RUNTIME_init_manager = "systemd"
VIRTUAL-RUNTIME_initscripts = "systemd-compat-units"

# Distro features
DISTRO_FEATURES = "ext2 ipv4 ipv6 largefile systemd usbgadget usbhost vpp pam virtualization polkit security"
```

## conf/machine/ls1046agtwy.conf
```bitbake
#@TYPE: Machine
#@NAME: NXP LS1046AGTWY
#@SOC: LSCH2
#@DESCRIPTION: Machine configuration for running LS1046A in 64-bit mode
#@MAINTAINER: Chunrong.guo <chunrong.guo@nxp.com>

MACHINEOVERRIDES =. "fsl-lsch2:ls1046a:"

require conf/machine/include/qoriq-arm64.inc
require conf/machine/include/arm/arch-arm64.inc

MACHINE_FEATURES += "optee"

KERNEL_CLASSES  = " kernel-fitimage "
KERNEL_IMAGETYPES = "fitImage"

# TODO : Verify Memory layout
UBOOT_DTB_LOADADDRESS = "0x90000000"
UBOOT_ENTRYPOINT = "0x80080000"

UBOOT_CONFIG ??= "tfa-secure-boot tfa"

# TODO : Update defconfig and secureboot
UBOOT_CONFIG[tfa] = "ls1046afrwy_tfa_defconfig"
UBOOT_CONFIG[tfa-secure-boot] = "ls1046afrwy_tfa_SECURE_BOOT_defconfig"

PREFERRED_PROVIDER_linux/kernel ?= "linux-ls1046afrwy"

# TODO : Add new kernel devicetree
KERNEL_DEVICETREE ?= "\
    freescale/fsl-ls1046a-frwy.dtb \
"
# TODO: rename in kernel
KERNEL_DEVICETREE:prepend:use-nxp-bsp = "\
    freescale/fsl-ls1046a-frwy-sdk.dtb \
    freescale/fsl-ls1046a-frwy-usdpaa.dtb \
"
KERNEL_DEFCONFIG ?= "defconfig"

# TODO : Update serial consoles
SERIAL_CONSOLES ?= "115200;ttyS0 115200;ttyAMA0 115200;ttyLP0"
SERIAL_CONSOLES_CHECK ?= "${SERIAL_CONSOLES}"

# Are we using QSpiboot for the gateway?
RCWQSPI ?= "NN_NNQNNPNP_3040_0506/rcw_1600_qspiboot"
RCWSD ?= "NN_NNQNNPNP_3040_0506/rcw_1600_sdboot"

FMAN_UCODE ?= "fsl_fman_ucode_ls1046_r1.0_106_4_18.bin"

EXTRA_IMAGEDEPENDS += "fm-ucode rcw qoriq-atf ls2-phy qe-ucode"
USE_VT = "0"
```
